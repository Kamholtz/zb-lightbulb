## light_bulb/nrf52840-dongle/Kconfig/Kconfig.shield
```kconfig
osource "c:/repos/zb-lightbulb/light_bulb/boards/shields/*/Kconfig.shield"
osource "C:/Users/carlk/ncs/v1.8.0/nrf/boards/shields/*/Kconfig.shield"
```
