## CMakeLists.txt
```
# SPDX-License-Identifier: Apache-2.0

cmake_minimum_required(VERSION 3.20.0)

project(button_press_handler)
# set(SOURCES main.c)
find_package(Zephyr REQUIRED HINTS $ENV{ZEPHYR_BASE})

# generate runner for the test
# set(SOURCES button_press_handler_test.c)
test_runner_generate(/home/carlk/repos/zb-lightbulb/light_bulb_dongle/test/src/button_press_handler_test.c)

# to make it appear under the "drivers" dir, the second param must be drivers
cmock_handle(${ZEPHYR_BASE}/include/zephyr/drivers/gpio.h drivers)

# add module uut
target_sources(app PRIVATE ../src/button_press_handler/button_press_handler.c)
target_include_directories(app PRIVATE ../src/button_press_handler)

# add test file
target_sources(app PRIVATE ./src/button_press_handler_test.c)
target_include_directories(app PRIVATE .)
# target_include_directories(app PRIVATE ./src)

# Preinclude file to the module under test to redefine IS_ENABLED() macro
# which is used in the module.
set_property(SOURCE ../src/button_press_handler/button_press_handler.c PROPERTY COMPILE_FLAGS
	"")
```

## prj.conf
```kconfig
CONFIG_UNITY=y
CONFIG_CONSOLE=y
CONFIG_STDOUT_CONSOLE=y
```

## src/button_press_handler_test.c
```c
#include "../../src/button_press_handler/button_press_handler.h"
#include <unity.h>
#include "drivers/mock_gpio.h"


#define RUN_LED_BLINK_INTERVAL          25

void test_get_button_press_handler() {
	// zassert_equal(0, 1, "0 is 0");
    struct Button_Press_Handler handler = get_button_press_handler();
	TEST_ASSERT_EQUAL(0, handler.completed_button_press_thresh);
}

void test_get_debounced_press() {
    struct Button_Press_Handler handler = get_button_press_handler();
    __wrap_gpio_pin_get_dt_ExpectAnyArgsAndReturn(0);
    handler.poll_interval_ms = 30;
    handler.debounce_timer_ms = 200;
    handler.press_timer_ms = 4970;
    handler.is_debounced = true;
    get_debounced_press(&handler);

    TEST_ASSERT_EQUAL(5000, handler.completed_button_press_thresh);
}

/* It is required to be added to each test. That is because unity is using
 * different main signature (returns int) and zephyr expects main which does
 * not return value.
 */
extern int unity_main(void);

void main(void)
{
	(void)unity_main();
}
```
